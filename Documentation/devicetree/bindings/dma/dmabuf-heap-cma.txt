## Documentation/devicetree/bindings/dma/dmabuf-heap-cma.txt
```
* DMA-BUF CMA Heap

Specifies a CMA region that should be added to the dma-buf heaps
interface.

Required properties:
- compatible: Must be "dmabuf-heap-cma"
- memory-region: phandle to a CMA reserved memory node

Example:
This example has a camera CMA node in reserved memory, which is then
referenced by the dmabuf-heap-cma node.


	reserved-memory {
		#address-cells = <2>;
		#size-cells = <2>;
		ranges;
		...
		cma_camera: cma-camera {
			compatible = "shared-dma-pool";
			reg = <0x0 0x24C00000 0x0 0x4000000>;
			reusable;
		};
		...
	};

       cma_heap {
               compatible = "dmabuf-heap-cma";
               memory-region = <&cma_camera>;
        };
```

## Documentation/devicetree/bindings/usb/hisi,dwc3.txt
```
HiSi SuperSpeed DWC3 USB SoC controller

Required properties:
- compatible:		should contain "hisilicon,hi3660-dwc3" for HiSi SoC
- clocks:		A list of phandle + clock-specifier pairs for the
			clocks listed in clock-names
- clock-names:		Should contain the following:
  "ref"			Reference clk
  "bus_early"		bus_early clk

- assigned-clocks:	Should be:
				HI3660_ACLK_GATE_USB3OTG
- assigned-clock-rates: Should be:
				229Mhz (229000000) for HI3660_ACLK_GATE_USB3OTG

Optional properties:
- resets:		Phandle to reset control that resets core and wrapper.

Required child node:
A child node must exist to represent the core DWC3 IP block. The name of
the node is not important. The content of the node is defined in dwc3.txt.

Example device nodes:

	usb3: usb3 {
		compatible = "hisilicon,hi3660-dwc3";
		#address-cells = <2>;
		#size-cells = <2>;
		ranges;

		clocks = <&crg_ctrl HI3660_CLK_ABB_USB>,
			 <&crg_ctrl HI3660_ACLK_GATE_USB3OTG>;
		clock-names = "ref", "bus_early";

		assigned-clocks = <&crg_ctrl HI3660_ACLK_GATE_USB3OTG>;
		assigned-clock-rates = <229000000>;
		resets = <&crg_rst 0x90 8>,
			 <&crg_rst 0x90 7>,
			 <&crg_rst 0x90 6>,
			 <&crg_rst 0x90 5>;

		dwc3: dwc3@ff100000 {
			compatible = "snps,dwc3";
			reg = <0x0 0xff100000 0x0 0x100000>;
			interrupts = <0 159 4>, <0 161 4>;
			phys = <&usb_phy>;
			phy-names = "usb3-phy";
			dr_mode = "otg";

			...
		};
	};
```
