## drivers/reset/hisilicon/Kconfig
```kconfig
config COMMON_RESET_HI3660
	tristate "Hi3660 Reset Driver"
	depends on ARCH_HISI || COMPILE_TEST
	default ARCH_HISI
	help
	  Build the Hisilicon Hi3660 reset driver.
```

## sound/soc/hisilicon/Kconfig
```kconfig
config SND_I2S_HI6210_I2S
	tristate "Hisilicon I2S controller"
	select SND_SOC_GENERIC_DMAENGINE_PCM
	help
	  Hisilicon I2S

config SND_SOC_PCM_HI6210
        tristate "SoC Audio support for HI6210"
        help
                Enable this option for HI6210 APB audio support.

config SND_HI6210_HISSC
        tristate "Hi6210-Hissc sound support"
        help
                This option enables sound support for Hi6210-Hissc.
                ssc mean Soc-Smartstar Codec.
config SND_SOC_CODEC_HISSC
        tristate "HI Soc Smartstar Codec support"
```
